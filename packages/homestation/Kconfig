## packages/homestation/Kconfig
```kconfig
menu "MQTT config"

config MQTT_PAYLOAD_CHANNEL_STRING_MAX_SIZE
	int "Payload maximum string size"
	default 100
	help
	  Maximum size of the string included messages that are sent over the payload channel.

rsource "src/modules/ble_scanner/Kconfig.ble_scanner"
rsource "src/modules/trigger/Kconfig.trigger"
rsource "src/modules/sampler/Kconfig.sampler"
rsource "src/modules/network/Kconfig.network"
rsource "src/modules/transport/Kconfig.transport"
rsource "src/modules/error/Kconfig.error"

endmenu

menu "Zephyr Kernel"
source "Kconfig.zephyr"
endmenu
```

## src/modules/ble_scanner/Kconfig.ble_scanner
```kconfig
#
# Copyright (c) 2023 Nordic Semiconductor
#
# SPDX-License-Identifier: LicenseRef-Nordic-5-Clause
#

menu "Ble Scanner"

config MQTT_SAMPLE_BLE_SCANNER_THREAD_STACK_SIZE
	int "Thread stack size"
	default 2048

config MQTT_SAMPLE_BLE_SCANNER_TIMEOUT_SECONDS
	int "Trigger timer timeout"
	default 60


module = MQTT_SAMPLE_BLE_SCANNER
module-str = BLE_SCANNER
source "subsys/logging/Kconfig.template.log_config"

endmenu # Trigger
```

## src/modules/sampler/Kconfig.sampler
```kconfig
menu "Sampler"

config MQTT_SAMPLER_THREAD_STACK_SIZE
	int "Thread stack size"
	default 1024

config MQTT_SAMPLER_MESSAGE_QUEUE_SIZE
	int "Message queue size"
	default 5
	help
	  ZBus subscriber message queue size.

module = MQTT_SAMPLER
module-str = Sampler
source "subsys/logging/Kconfig.template.log_config"

endmenu # Sampler
```
