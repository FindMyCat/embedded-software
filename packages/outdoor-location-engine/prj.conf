## CMakeLists.txt
```
cmake_minimum_required(VERSION 3.20)

find_package(Zephyr REQUIRED HINTS $ENV{ZEPHYR_BASE})
project(find_my_cat)

zephyr_library_sources(src/main.c)

# Link all external dependencies

target_sources(app PRIVATE src/LocationEngine/LocationEngine.c)
target_sources(app PRIVATE src/LocationEngine/LocationEngine.h)

target_sources(app PRIVATE src/SmsListener/SmsListener.c)
target_sources(app PRIVATE src/SmsListener/SmsListener.h)

target_sources(app PRIVATE src/UDPListener/UDPListener.c)
target_sources(app PRIVATE src/UDPListener/UDPListener.h)

target_sources(app PRIVATE src/UDPListener/NewUDPListener.c)
target_sources(app PRIVATE src/UDPListener/NewUDPListener.h)

target_sources(app PRIVATE src/Dispatcher/Dispatcher.c)
target_sources(app PRIVATE src/Dispatcher/Dispatcher.h)


target_sources(app PRIVATE src/Responder/Responder.c)
target_sources(app PRIVATE src/Responder/Responder.h)

target_sources(app PRIVATE src/mqtt/mqttsn.c)
target_sources(app PRIVATE src/mqtt/mqttsn.h)

target_sources(app PRIVATE src/utils/network.c)
target_sources(app PRIVATE src/utils/network.h)
```

## Kconfig
```
menu "Find My Cat main configuration"

config LTE_CONNECT_RETRY_DELAY_S
	int "Seconds to delay before attempting to retry LTE connection"
	default 20

config LTE_CONNECT_MAX_RETRIES
	int "Max retry attempts for LTE connection"
	default 4

config FINDMYCAT_CLOUD_HOSTNAME
	string "Hostname of the FindMyCat Cloud"

config MQTT_SN_GATEWAY_PORT
	int "Port of the MQTT-SN gateway"

config MQTT_SN_BUFFER_SIZE
	int "Size of the TX and RX buffers"
	default 255

config MQTT_SN_PUBLISH_TOPIC
	string "MQTT Topic to publish to"
	default "/location"

config MQTT_SN_REFRESH_PERIOD_SECONDS
	int "MQTT-SN refresh period in seconds"
	default 60

config LOCATION_SERVICES_INIT_MAX_RETRIES
	int "Max retry attempts for location services initialization"
	default 4

config LOCATION_SERVICES_INIT_RETRY_DELAY_S
	int "Seconds to delay before attempting to retry location services initialization"
	default 20

config DEVICE_ID
	string "Device ID"
	default "nrf9160"

config ACTIVE_MODE_LOCATION_REFRESH_PERIOD_SECONDS
	int "Location refresh period in seconds for Active Mode"
	default 1800	

config LOST_MODE_LOCATION_REFRESH_PERIOD_SECONDS
	int "Location refresh period in seconds for Lost Mode"
	default 30	

endmenu

menu "Zephyr Kernel"
source "Kconfig.zephyr"
endmenu

module = FINDMYCAT_OUTDOOR_LOCATION_ENGINE
module-str = FindMyCat outdoor location engine
source "${ZEPHYR_BASE}/subsys/logging/Kconfig.template.log_config"
```

## prj.conf
```kconfig
# General config
CONFIG_FPU=y
CONFIG_NEWLIB_LIBC=y
CONFIG_NEWLIB_LIBC_FLOAT_PRINTF=y
CONFIG_NRF_MODEM_LIB=y
CONFIG_CJSON_LIB=y
CONFIG_SMS=y
CONFIG_SMS_SUBSCRIBERS_MAX_CNT=2
CONFIG_GPIO=y
CONFIG_DATE_TIME=y # Library that maintains the current date time UTC for A-GPS and P-GPS purposes

# Device config
CONFIG_DEVICE_ID="your-findmycat-device-id"

# MQTT-SN config
CONFIG_MQTT_SN_LIB=y
CONFIG_MQTT_SN_TRANSPORT_UDP=y
CONFIG_FINDMYCAT_CLOUD_HOSTNAME="your-findmycat-cloud-hostname"
CONFIG_MQTT_SN_GATEWAY_PORT=1885
CONFIG_MQTT_SN_PUBLISH_TOPIC="/location"

# nRF Cloud (for A-GPS and cell location)
CONFIG_NRF_CLOUD_REST=y
CONFIG_NRF_CLOUD_AGPS=y
CONFIG_MODEM_INFO=y # required by CONFIG_NRF_CLOUD_AGPS
CONFIG_MODEM_INFO_ADD_NETWORK=y # required by CONFIG_NRF_CLOUD_AGPS

CONFIG_NRF_MODEM_LIB_SYS_INIT=y
CONFIG_NET_LOG=y
CONFIG_NRF_CLOUD_LOG_LEVEL_DBG=y
CONFIG_NRF_CLOUD_CLIENT_ID_SRC_IMEI=n
CONFIG_NRF_CLOUD_CLIENT_ID_PREFIX=""
CONFIG_NRF_CLOUD_CLIENT_ID_SRC_INTERNAL_UUID=y

# Heap and stacks
CONFIG_MAIN_STACK_SIZE=2048
# Extended memory heap size needed for encoding REST messages to JSON
CONFIG_HEAP_MEM_POOL_SIZE=8192
CONFIG_SYSTEM_WORKQUEUE_STACK_SIZE=1536
# Increase AT monitor heap because %NCELLMEAS notifications can be large
CONFIG_AT_MONITOR_HEAP_SIZE=512

# Location library
CONFIG_LOCATION=y
CONFIG_LOCATION_DATA_DETAILS=y

# Logging
CONFIG_LOG=y
CONFIG_LOG_MODE_IMMEDIATE=y
CONFIG_FINDMYCAT_OUTDOOR_LOCATION_ENGINE_LOG_LEVEL_DBG=y

# Network
CONFIG_NETWORKING=y
CONFIG_NET_NATIVE=n
CONFIG_NET_SOCKETS=y
CONFIG_NET_SOCKETS_OFFLOAD=y

# LTE link control
CONFIG_LTE_LINK_CONTROL=y
CONFIG_LTE_NETWORK_MODE_LTE_M_GPS=y
CONFIG_LTE_AUTO_INIT_AND_CONNECT=n

# eDRX
CONFIG_LTE_EDRX_REQ=y
CONFIG_LTE_EDRX_REQ_VALUE_LTE_M="0010"


# AT Host library - Used to send AT commands directy from an UART terminal and to allow
#		    integration with nRF Connect for Desktop LTE Link monitor application.
CONFIG_UART_INTERRUPT_DRIVEN=n
CONFIG_AT_HOST_LIBRARY=n


# Uncomment the below and set above to "n" to test no - assisted gps.
# TODO: can we use external AGPS service that is free? 
# CONFIG_LOCATION_SERVICE_EXTERNAL=y
# CONFIG_MULTICELL_LOCATION_SERVICE_NRF_CLOUD=n
# CONFIG_LOCATION_SERVICE_NRF_CLOUD=n

# Modem JWT
CONFIG_MODEM_JWT=y
CONFIG_MODEM_KEY_MGMT=y
CONFIG_HW_ID_LIBRARY=y

# Logging
CONFIG_SERIAL=y
CONFIG_USE_SEGGER_RTT=y
CONFIG_RTT_CONSOLE=y
CONFIG_UART_CONSOLE=y
CONFIG_NRF_MODEM_LIB_TRACE=y

# Debug logs
CONFIG_SMS_LOG_LEVEL_DBG=y
CONFIG_LTE_LINK_CONTROL_LOG_LEVEL_DBG=y
CONFIG_NRF_CLOUD_GPS_LOG_LEVEL_DBG=y

# Refresh rates

CONFIG_MQTT_SN_REFRESH_PERIOD_SECONDS=5
CONFIG_ACTIVE_MODE_LOCATION_REFRESH_PERIOD_SECONDS=1800
CONFIG_LOST_MODE_LOCATION_REFRESH_PERIOD_SECONDS=30
```

## src/main.c
```c
// Libraries
#include <string.h>
#include <zephyr/kernel.h>
#include <nrf_modem_at.h>
#include <modem/lte_lc.h>
#include <modem/location.h>
#include <date_time.h>
#include <zephyr/logging/log.h>

#include <zephyr/drivers/gpio.h>

// Application specific imports
#include "LocationEngine/LocationEngine.h"
#include "Dispatcher/Dispatcher.h"
#include "Responder/Responder.h"
#include "UDPListener/NewUDPListener.h"

LOG_MODULE_REGISTER(main, 4);

/* Indoor location engine sends 1 for PSM mode and 0 for eDRX mode */
#define POWER_MODE_COMMAND_PIN		DT_ALIAS(gpiocus10)

static const struct gpio_dt_spec power_mode_command_recv_pin = GPIO_DT_SPEC_GET_OR(POWER_MODE_COMMAND_PIN, gpios, {0});

static K_SEM_DEFINE(lte_connected, 0, 1);

static K_SEM_DEFINE(time_update_finished, 0, 1);

static void date_time_evt_handler(const struct date_time_evt *evt)
{
	k_sem_give(&time_update_finished);
}

static void lte_event_handler(const struct lte_lc_evt *const evt)
{
	LOG_INF("************************************* LTE event: %d", evt->type);
	switch (evt->type) {
	case LTE_LC_EVT_NW_REG_STATUS:
		if ((evt->nw_reg_status == LTE_LC_NW_REG_REGISTERED_HOME) ||
		     (evt->nw_reg_status == LTE_LC_NW_REG_REGISTERED_ROAMING)) {
			LOG_INF("Connected to LTE");
			k_sem_give(&lte_connected);
		}
		if (evt->nw_reg_status == LTE_LC_NW_REG_SEARCHING) {
			char resp[256];
			
			nrf_modem_at_cmd(resp, sizeof(resp), "AT%%XSIM?");
			LOG_INF("SIM status: %s", resp);
			
			nrf_modem_at_cmd(resp, sizeof(resp), "AT+CIMI");
			LOG_INF("IMSI: %s", resp);
			
			nrf_modem_at_cmd(resp, sizeof(resp), "AT+CRSM=176,28539,0,0,12");
			LOG_INF("FPLMN: %s", resp);
			
			nrf_modem_at_cmd(resp, sizeof(resp), "AT%%XMONITOR");
			LOG_INF("Monitor: %s", resp);
		    	
			nrf_modem_at_cmd(resp, sizeof(resp), "AT+CESQ");
		   	LOG_INF("Signal: %s", resp);

			nrf_modem_at_cmd(resp, sizeof(resp), "AT%%CONEVAL");
			LOG_INF("Connection eval: %s", resp);

			nrf_modem_at_cmd(resp, sizeof(resp), "AT%%XCBAND");
			LOG_INF("Current band: %s", resp);
		    }

		break;
	default:
		break;
	}
}

/**
 * @brief Initialize LTE and wait for connection.
*/
static int initializeLte() {
	int err;

	if (IS_ENABLED(CONFIG_DATE_TIME)) {
		/* Registering early for date_time event handler to avoid missing
		 * the first event after LTE is connected.
		 */
		date_time_register_handler(date_time_evt_handler);
	}

	LOG_INF("Connecting to LTE...");

	lte_lc_init();
	lte_lc_register_handler(lte_event_handler);

	/* Enable PSM. */
	/* Turn on LTE power saving features. Also,
	 * request power saving features before network registration. Some
	 * networks rejects timer updates after the device has registered to the
	 * LTE network.
	 */
	lte_lc_psm_req(false);
	/** enhanced Discontinuous Reception */

	LOG_INF("Requesting EDRX mode");
	// Todo: Turn on EDRX mode after development complete.
	err = lte_lc_edrx_req(false);
	
	if (err) {
		LOG_INF("lte_lc_edrx_req, error: %d\n", err);
	}

	/* Unlock all bands — let modem scan freely and pick the best available. */
	char band_resp[64];
	nrf_modem_at_cmd(band_resp, sizeof(band_resp), "AT%%XBANDLOCK=0");
	LOG_INF("Band lock cleared: %s", band_resp);

	err = lte_lc_connect();

	k_sem_take(&lte_connected, K_FOREVER);

	return err;
}

/**
 * @brief Initialize location services.
 * 
 * DOES NOT call method to request location, only initializes the library.
*/
static int initializeLocation() {
		/* A-GPS/P-GPS needs to know the current time. */
	if (IS_ENABLED(CONFIG_DATE_TIME)) {
		LOG_INF("Waiting for current time");

		/* Wait for an event from the Date Time library. */
		k_sem_take(&time_update_finished, K_MINUTES(10));

		if (!date_time_is_valid()) {
			LOG_INF("Failed to get current time. Continuing anyway.");
		}
	}

	int err = location_init(location_event_handler);
	if (err) {
		LOG_INF("Initializing the Location library failed, error: %d", err);
		return -1;
	}
	
	return err;
}

#define BUTTON_DEBOUNCE_TIME 50
uint32_t last_button_press_time;
/**
 * @brief Callback function for when the power mode command is received through gpio interrupt.
*/
static void power_mode_command_recieved() {
	k_sleep(K_MSEC(100));
	int power_mode_command = gpio_pin_get_dt(&power_mode_command_recv_pin);
 	uint32_t newPressTime = k_uptime_get_32();
	
	if (k_uptime_get_32() - last_button_press_time < BUTTON_DEBOUNCE_TIME) {
		return;
	}

	if (power_mode_command == 0) {
		LOG_INF("Power mode set to eDRX");
		// lte_lc_psm_req(false);
		lte_lc_edrx_req(true);
		
	} else if (power_mode_command == 1) {
		LOG_INF("Power mode set to PSM");
		lte_lc_psm_req(true);
		lte_lc_edrx_req(false);
	}
	
	last_button_press_time = newPressTime;

}

static struct gpio_callback pwr_mode_cb_data;


/**
 * @brief Application entry point.
*/
int main(void) {


	LOG_INF("*******************************");
	LOG_INF("Welcome to FindMyCat v2.0");
	LOG_INF("*******************************");
	
retry:
	if (!device_is_ready(power_mode_command_recv_pin.port)) {
		LOG_ERR("Error: Device %s is not ready\n", power_mode_command_recv_pin.port->name);
		goto retry;
	}

	int err;	
	int retry_count = 0;

	err = gpio_pin_configure_dt(&power_mode_command_recv_pin, GPIO_INPUT | GPIO_PULL_DOWN);
	if (err != 0) {
		LOG_ERR("Error %d: failed to configure %s pin %d\n", 
			err, power_mode_command_recv_pin.port->name, power_mode_command_recv_pin.pin);
		goto retry;
	}

	err = gpio_pin_interrupt_configure_dt(&power_mode_command_recv_pin, GPIO_INT_EDGE_BOTH);
	if (err != 0) {
		LOG_ERR("Error %d: failed to configure interrupt on %s pin %d\n",
			err, power_mode_command_recv_pin.port->name, power_mode_command_recv_pin.pin);
		return -1;
	}


	gpio_init_callback(&pwr_mode_cb_data, power_mode_command_recieved, BIT(power_mode_command_recv_pin.pin));
	gpio_add_callback(power_mode_command_recv_pin.port, &pwr_mode_cb_data);

	// Connect to LTE network with retries if necessary.
    while (retry_count < CONFIG_LTE_CONNECT_MAX_RETRIES) {
        err = initializeLte();

        if (err) {
            LOG_INF("Failed to connect to LTE with error: %d\n", err);
            retry_count++;
            k_sleep(K_MSEC(CONFIG_LTE_CONNECT_RETRY_DELAY_S * 1000));
        } else {
			break;
		}
    }

	if (retry_count == CONFIG_LTE_CONNECT_MAX_RETRIES) {
	    LOG_ERR("Max retry limit reached for connecting to LTE, program exiting.");
		return -1;
	}

	retry_count = 0;
	// Initialize location services with retries if necessary.
    while (retry_count < CONFIG_LOCATION_SERVICES_INIT_MAX_RETRIES) {
        err = initializeLocation();

        if (err) {
            LOG_INF("Failed to initialize location services with error: %d\n", err);
            retry_count++;
            k_sleep(K_MSEC(CONFIG_LOCATION_SERVICES_INIT_RETRY_DELAY_S * 1000));
        } else {
			break;
		}
    }

	if (retry_count == CONFIG_LTE_CONNECT_MAX_RETRIES) {
	    LOG_ERR("Max retry limit reached for initializing location services, program exiting.");
		return -1;
	}


	retry_count = 0;
	// Initialize UDP listener with retries (using the same retry count as location services)
    while (retry_count < CONFIG_LOCATION_SERVICES_INIT_MAX_RETRIES) {
        err = create_udp_listener();

        if (err) {
            LOG_INF("Failed to create UDP Listener with error: %d\n", err);
			destroy_udp_listener();
            retry_count++;
            k_sleep(K_MSEC(CONFIG_LOCATION_SERVICES_INIT_RETRY_DELAY_S * 1000));
        } else {
			LOG_INF("Created UDP Listener.");
			break;
		}
    }

	// Start the UDP listener thread.
	start_udp_listener_thread();

	
	while (true)
	{
		LOG_INF("Main thread is running.");
		k_sleep(K_MSEC(4000));
	}
	

	return 0;
}
```
