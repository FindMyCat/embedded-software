## packages/homestation-esp32/app/src/modules/lora/Kconfig.lora
```kconfig
menu "LoRa"

config LORA_THREAD_STACK_SIZE
	int "Thread stack size"
	default 8192

config LORA_ABSENCE_S
	int "Seconds without a frame from the collar before it counts as gone"
	default 900

config LORA_LOCATE_WINDOW_S
	int "Seconds to keep pinging after the locate button is pressed"
	default 180

config LORA_BEACON_INTERVAL_S
	int "Seconds between LoRa beacons"
	default 1
	help
	  Only used with LORA_REPLY_TO_HEARTBEAT off.

config LORA_PING_PREAMBLE
	int "Ping preamble length in symbols"
	default 384
	help
	  Spans two of the collar's 185 ms sniffs whatever the phase; 192
	  cleared one by only ~12 ms. Must match the collar's
	  CONFIG_LORA_LINK_PEER_PREAMBLE.

config LORA_REPLY_TO_HEARTBEAT
	bool "Transmit only in reply to the collar's heartbeat"
	default y
	help
	  Each heartbeat marks the start of a collar CAD burst, so a beacon or
	  a pending ping sent straight back is heard, and the periodic beacon
	  is not needed. Locate latency becomes the collar's heartbeat period.
	  Off restores beaconing every CONFIG_LORA_BEACON_INTERVAL_S.

config LORA_PAUSE_FOR_BLE
	bool "Stop LoRa receive while the tag is in BLE range"
	help
	  Off keeps the receiver on regardless, so the collar's heartbeats are
	  still answered when it is in BLE range.

config LORA_TX_POWER_DBM
	int "P2P transmit power in dBm (5-22)"
	range 5 22
	default 22
	help
	  Max: the collar hears us by CAD, which needs more margin than our
	  full receive.

module = LORA
module-str = LoRa
source "subsys/logging/Kconfig.template.log_config"

endmenu # LoRa
```

## packages/homestation-esp32/app/src/modules/wifi/Kconfig.wifi
```kconfig
menu "WiFi"

config WIFI_STATION_SSID
	string "Home access point SSID"
	default ""

config WIFI_STATION_PSK
	string "Home access point password"
	default ""
	help
	  Leave empty for an open network. Set this in a gitignored local.conf,
	  never in prj.conf.

config WIFI_STATION_CONNECT_TIMEOUT_S
	int "Seconds to wait for an IPv4 address"
	default 60

module = WIFI
module-str = WiFi
source "subsys/logging/Kconfig.template.log_config"

endmenu # WiFi
```
