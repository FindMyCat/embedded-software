## packages/homestation-esp32/app/src/modules/ble/Kconfig.ble
```kconfig
menu "BLE scanner"

config BLE_SCANNER
	bool "Detect the tag from its BLE advertisements"
	depends on BT_OBSERVER
	help
	  Scans passively and matches the FMC magic in the tag's manufacturer
	  data, which is where it identifies itself and reports its battery.
	  This is the short-range half of the presence picture; the LoRa link is
	  the long-range half.

config BLE_SCANNER_ABSENCE_S
	int "Seconds without an advertisement before the tag counts as gone"
	depends on BLE_SCANNER
	default 30
	help
	  Several advertising intervals, so a few lost packets do not read as
	  the tag having left.

module = BLE_SCANNER
module-str = BLE scanner
source "subsys/logging/Kconfig.template.log_config"

config BLE_BEACON
	bool "Advertise as homestation over BLE so the collar can tell it is home"
	depends on BT_BROADCASTER
	help
	  The collar scans for BT_DEVICE_NAME and uses the result to choose
	  between PSM and eDRX.

module = BLE_BEACON
module-str = BLE beacon
source "subsys/logging/Kconfig.template.log_config"

endmenu # BLE scanner
```

## packages/homestation-esp32/app/src/modules/error/Kconfig.error
```kconfig
menu "Error"

config ERROR_REBOOT_ON_FATAL
	bool "Reboot on fatal error"
	depends on REBOOT
	default y

module = ERROR
module-str = Error
source "subsys/logging/Kconfig.template.log_config"

endmenu # Error
```

## packages/homestation-esp32/app/src/modules/led/Kconfig.led
```kconfig
menu "Status LED"

choice STATUS_LED_EFFECT
	prompt "Status colour animation"
	default STATUS_LED_BREATHE

config STATUS_LED_BREATHE
	bool "Smooth fade in and out"

config STATUS_LED_CANDLE
	bool "Candle flicker"

endchoice

endmenu # Status LED
```

## packages/homestation-esp32/app/src/modules/lora/Kconfig.lora
```kconfig
menu "LoRa"

config LORA_THREAD_STACK_SIZE
	int "Thread stack size"
	default 8192

config LORA_MESSAGE_QUEUE_SIZE
	int "Message queue size"
	default 4

config LORA_ABSENCE_S
	int "Seconds without a frame from the collar before it counts as gone"
	default 900


config LORA_LOCATE_WINDOW_S
	int "Seconds to keep pinging after the locate button is pressed"
	default 180

config LORA_BEACON_INTERVAL_S
	int "Seconds between LORA beacons"
	default 30

config LORA_PING_PREAMBLE
	int "Ping preamble length in symbols"
	default 512

config LORA_REPLY_TO_HEARTBEAT
	bool "Transmit only in reply to the collar's heartbeat"
	default y
	help
	  Each heartbeat marks the start of a collar CAD burst, so a beacon or
	  a pending ping sent straight back is heard, and the periodic beacon
	  is not needed. Locate latency becomes the collar's heartbeat period.
	  Off restores beaconing every CONFIG_LORA_BEACON_INTERVAL_S.

config LORA_PAUSE_FOR_BLE
	bool "Stop LoRa receive while the tag is in BLE range"
	default y
	help
	  Off keeps the receiver on regardless, for testing the LoRa link with
	  the collar nearby.

config LORA_TX_POWER_DBM
	int "P2P transmit power in dBm (5-22)"
	default 5

module = LORA
module-str = LoRa
source "subsys/logging/Kconfig.template.log_config"

endmenu # LoRa
```

## packages/homestation-esp32/app/src/modules/mqtt/Kconfig.mqtt
```kconfig
menu "MQTT publisher"

config MQTT_PUBLISHER
	bool "Report the station's own position while the tag is in BLE range"
	depends on MQTT_LIB && NET_TCP
	help
	  The tag being within BLE range places it at the station, so the
	  station publishes its own coordinates on the tag's behalf.

if MQTT_PUBLISHER

config MQTT_PUBLISHER_BROKER_HOST
	string "Broker address"
	help
	  This needs to be the IP address instead of the DNS due to the RAM constraints of ESP32

config MQTT_PUBLISHER_BROKER_PORT
	int "Broker port"
	default 8883 if MQTT_PUBLISHER_TLS
	default 1883

config MQTT_PUBLISHER_TLS
	bool "Connect to the broker over TLS"
	depends on MQTT_LIB_TLS && TLS_CREDENTIALS
	help
	  Without this the position and the device identity cross the network in
	  the clear, and anyone who learns the client id can publish positions
	  as this station. Needs the broker's CA certificate in
	  ca_certificate.h.

config MQTT_PUBLISHER_SEC_TAG
	int "Security tag the CA certificate is registered under"
	depends on MQTT_PUBLISHER_TLS
	default 955
	help
	  Any value not used by another credential on this device.

config MQTT_PUBLISHER_LOCATION_TOPIC
	string "Topic to publish positions to"
	help
	  Must match the topic the location rule reads.

config MQTT_PUBLISHER_HOME_LATITUDE
	string "Station latitude, in decimal degrees"
	help
	  Published verbatim, so it has to be in the form the rule expects.

config MQTT_PUBLISHER_HOME_LONGITUDE
	string "Station longitude, in decimal degrees"

config MQTT_PUBLISHER_HOME_ACCURACY_M
	int "Accuracy to report, in metres"
	default 15
	help
	  How far the tag can be from the station and still be heard over BLE,
	  which is the real uncertainty in this position.

config MQTT_PUBLISHER_INTERVAL_S
	int "Seconds between reports while the tag stays in range"
	default 30

config MQTT_PUBLISHER_THREAD_STACK_SIZE
	int "Publisher thread stack size"
	default 4096

module = MQTT_PUBLISHER
module-str = MQTT publisher
source "subsys/logging/Kconfig.template.log_config"

endif # MQTT_PUBLISHER

endmenu # MQTT publisher
```

## packages/homestation-esp32/app/src/modules/trigger/Kconfig.trigger
```kconfig
menu "Trigger"

config TRIGGER_THREAD_STACK_SIZE
	int "Thread stack size"
	default 512

config TRIGGER_TIMEOUT_SECONDS
	int "Trigger interval in seconds"
	default 30

module = TRIGGER
module-str = Trigger
source "subsys/logging/Kconfig.template.log_config"

endmenu # Trigger
```

## packages/homestation-esp32/app/src/modules/wifi/Kconfig.wifi
```kconfig
menu "WiFi"

config WIFI_STATION_SSID
	string "Home access point SSID"
	default ""

config WIFI_STATION_PSK
	string "Home access point password"
	default ""
	help
	  Leave empty for an open network. Set this in a gitignored local.conf,
	  never in prj.conf.

config WIFI_STATION_CONNECT_TIMEOUT_S
	int "Seconds to wait for an IPv4 address"
	default 60

config WIFI_GEOLOCATION
	bool "Resolve access point lists to a position via Google Geolocation"
	depends on HTTP_CLIENT
	depends on JSON_LIBRARY

if WIFI_GEOLOCATION

config WIFI_GEOLOCATION_API_KEY
	string "Google Geolocation API key"
	default ""
	help
	  Set this in a gitignored local.conf, never in prj.conf.

config WIFI_GEOLOCATION_HOST
	string "Geolocation API host"
	default "www.googleapis.com"

config WIFI_GEOLOCATION_TIMEOUT_S
	int "Request timeout in seconds"
	default 20

endif # WIFI_GEOLOCATION

module = WIFI
module-str = WiFi
source "subsys/logging/Kconfig.template.log_config"

endmenu # WiFi
```

## packages/homestation-esp32/manifest/west.yml
```yaml
manifest:
  self:
    path: manifest

  remotes:
    - name: zephyrproject-rtos
      url-base: https://github.com/zephyrproject-rtos

  projects:
    - name: zephyr
      remote: zephyrproject-rtos
      revision: 4564d775ab0b0458947d4988a8bb1dec2d9c3e9a
      import: true
```

## packages/outdoor-location-engine/manifest/west.yml
```yaml
manifest:
  self:
    path: manifest

  remotes:
    - name: nrfconnect
      url-base: https://github.com/nrfconnect

  projects:
    - name: nrf
      remote: nrfconnect
      repo-path: sdk-nrf
      revision: v3.2.4
      import: true
```
