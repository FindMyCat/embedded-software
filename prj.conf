## CMakeLists.txt
```
cmake_minimum_required(VERSION 3.20)

find_package(Zephyr REQUIRED HINTS $ENV{ZEPHYR_BASE})
project(find_my_cat)

zephyr_library_sources(src/main.c)

# Link all external dependencies

target_sources(app PRIVATE src/LocationEngine/LocationEngine.c)
target_sources(app PRIVATE src/LocationEngine/LocationEngine.h)

target_sources(app PRIVATE src/SmsListener/SmsListener.c)
target_sources(app PRIVATE src/SmsListener/SmsListener.h)

target_sources(app PRIVATE src/UDPListener/UDPListener.c)
target_sources(app PRIVATE src/UDPListener/UDPListener.h)

target_sources(app PRIVATE src/Dispatcher/Dispatcher.c)
target_sources(app PRIVATE src/Dispatcher/Dispatcher.h)


target_sources(app PRIVATE src/Responder/Responder.c)
target_sources(app PRIVATE src/Responder/Responder.h)

target_sources(app PRIVATE src/mqtt/mqttsn.c)
target_sources(app PRIVATE src/mqtt/mqttsn.h)
```

## Kconfig
```
menu "Find My Cat main configuration"
config MQTT_PUB_TOPIC
	string "MQTT publish topic"
	default "my/publish/topic"

config MQTT_SUB_TOPIC
	string "MQTT subscribe topic"
	default "my/subscribe/topic"

config MQTT_CLIENT_ID
	string "MQTT Client ID"
	help
	  Use a custom Client ID string. If not set, the client ID will be
	  generated based on IMEI number (for nRF9160 based targets) or
	  randomly (for other platforms).
	default ""

config MQTT_BROKER_HOSTNAME
	string "MQTT broker hostname"
	default "test.mosquitto.org"

config MQTT_BROKER_PORT
	int "MQTT broker port"
	default 1883

config MQTT_MESSAGE_BUFFER_SIZE
	int "MQTT message buffer size"
	default 128

config MQTT_PAYLOAD_BUFFER_SIZE
	int "MQTT payload buffer size"
	default 128

config MQTT_RECONNECT_DELAY_S
	int "Seconds to delay before attempting to reconnect to the broker"
	default 60

config LTE_CONNECT_RETRY_DELAY_S
	int "Seconds to delay before attempting to retry LTE connection"
	default 20

config LTE_CONNECT_MAX_RETRIES
	int "Max retry attempts for LTE connection"
	default 4

config MQTT_TLS_SEC_TAG
	int "TLS credentials security tag"
	default 24

config MQTT_TLS_SESSION_CACHING
	bool "Enable TLS session caching"

config MQTT_TLS_PEER_VERIFY
	int "Set peer verification level"
	default 2
	help
		Set to 0 for VERIFY_NONE, 1 for VERIFY_OPTIONAL, and 2 for
		VERIFY_REQUIRED.

config MQTT_BROKER_USERNAME
	string "MQTT Broker username"
	default "username"
	help
	    Set to "username", change this to your username.

config MQTT_BROKER_PASSWORD
	string "MQTT Broker password"
	default "password"
	help
	    Set to "password", change this to your password.

config MQTT_SN_GATEWAY_IP
	string "IP of the MQTT-SN gateway"

config MQTT_SN_GATEWAY_PORT
	int "Port of the MQTT-SN gateway"

config MQTT_SN_BUFFER_SIZE
	int "Size of the TX and RX buffers"
	default 255

config LOCATION_SERVICES_INIT_MAX_RETRIES
	int "Max retry attempts for location services initialization"
	default 4

config LOCATION_SERVICES_INIT_RETRY_DELAY_S
	int "Seconds to delay before attempting to retry location services initialization"
	default 20

config DEVICE_ID
	string "Device ID"
	default "nrf9160"

config MQTT_SN_REFRESH_PERIOD_SECONDS
	int "MQTT-SN refresh period in seconds"
	default 60

config LOCATION_REFRESH_PERIOD_SECONDS
	int "Location refresh period in seconds"
	default 60	

endmenu

menu "Zephyr Kernel"
source "Kconfig.zephyr"
endmenu

module = FINDMYCAT_OUTDOOR_LOCATION_ENGINE
module-str = FindMyCat outdoor location engine
source "${ZEPHYR_BASE}/subsys/logging/Kconfig.template.log_config"
```

## sample.yaml
```
sample:
  name: location Sample
tests:
  sample.nrf9160.location:
    build_only: true
    integration_platforms:
      - nrf9160dk_nrf9160_ns
    platform_allow: nrf9160dk_nrf9160_ns
    tags: ci_build
  sample.nrf9160.location.pgps:
    build_only: true
    extra_args: OVERLAY_CONFIG=overlay-pgps.conf
    integration_platforms:
      - nrf9160dk_nrf9160_ns
    platform_allow: nrf9160dk_nrf9160_ns
    tags: ci_build
```

## prj.conf
```kconfig
# General config
CONFIG_FPU=y
CONFIG_NEWLIB_LIBC=y
CONFIG_NEWLIB_LIBC_FLOAT_PRINTF=y
CONFIG_NRF_MODEM_LIB=y
CONFIG_CJSON_LIB=y
CONFIG_SMS=y
CONFIG_SMS_SUBSCRIBERS_MAX_CNT=2
CONFIG_GPIO=y
CONFIG_DATE_TIME=y # Library that maintains the current date time UTC for A-GPS and P-GPS purposes

# Device config
CONFIG_DEVICE_ID="60315313"

# MQTT-SN config
CONFIG_MQTT_SN_LIB=y
CONFIG_MQTT_SN_TRANSPORT_UDP=y
CONFIG_MQTT_SN_GATEWAY_IP="18.191.185.127"
CONFIG_MQTT_SN_GATEWAY_PORT=1885

# nRF Cloud (for A-GPS and cell location)
CONFIG_NRF_CLOUD_REST=y
CONFIG_NRF_CLOUD_AGPS=y
CONFIG_MODEM_INFO=y # required by CONFIG_NRF_CLOUD_AGPS
CONFIG_MODEM_INFO_ADD_NETWORK=y # required by CONFIG_NRF_CLOUD_AGPS

CONFIG_NRF_MODEM_LIB_SYS_INIT=y
CONFIG_NET_LOG=y
CONFIG_NRF_CLOUD_LOG_LEVEL_DBG=y
CONFIG_NRF_CLOUD_CLIENT_ID_SRC_IMEI=n
CONFIG_NRF_CLOUD_CLIENT_ID_PREFIX=""
CONFIG_NRF_CLOUD_CLIENT_ID_SRC_INTERNAL_UUID=y

# Heap and stacks
CONFIG_MAIN_STACK_SIZE=2048
# Extended memory heap size needed for encoding REST messages to JSON
CONFIG_HEAP_MEM_POOL_SIZE=8192
CONFIG_SYSTEM_WORKQUEUE_STACK_SIZE=1536
# Increase AT monitor heap because %NCELLMEAS notifications can be large
CONFIG_AT_MONITOR_HEAP_SIZE=512

# Location library
CONFIG_LOCATION=y
CONFIG_LOCATION_DATA_DETAILS=y

# Logging
CONFIG_LOG=y
CONFIG_LOG_MODE_IMMEDIATE=y
CONFIG_FINDMYCAT_OUTDOOR_LOCATION_ENGINE_LOG_LEVEL_DBG=y

# Network
CONFIG_NETWORKING=y
CONFIG_NET_NATIVE=n
CONFIG_NET_SOCKETS=y
CONFIG_NET_SOCKETS_OFFLOAD=y

# LTE link control
CONFIG_LTE_LINK_CONTROL=y
CONFIG_LTE_NETWORK_MODE_LTE_M_GPS=y
CONFIG_LTE_AUTO_INIT_AND_CONNECT=n

# eDRX
CONFIG_LTE_EDRX_REQ=y
CONFIG_LTE_EDRX_REQ_VALUE_LTE_M="0010"


# AT Host library - Used to send AT commands directy from an UART terminal and to allow
#		    integration with nRF Connect for Desktop LTE Link monitor application.
CONFIG_UART_INTERRUPT_DRIVEN=n
CONFIG_AT_HOST_LIBRARY=n


# Uncomment the below and set above to "n" to test no - assisted gps.
# TODO: can we use external AGPS service that is free? 
# CONFIG_LOCATION_SERVICE_EXTERNAL=y
# CONFIG_MULTICELL_LOCATION_SERVICE_NRF_CLOUD=n
# CONFIG_LOCATION_SERVICE_NRF_CLOUD=n

# Modem JWT
CONFIG_MODEM_JWT=y
CONFIG_MODEM_KEY_MGMT=y
CONFIG_HW_ID_LIBRARY=y

# Logging
CONFIG_SERIAL=y
CONFIG_USE_SEGGER_RTT=y
CONFIG_RTT_CONSOLE=y
CONFIG_UART_CONSOLE=y
CONFIG_NRF_MODEM_LIB_TRACE=y

# Debug logs
CONFIG_SMS_LOG_LEVEL_DBG=y
CONFIG_LTE_LINK_CONTROL_LOG_LEVEL_DBG=y
CONFIG_NRF_CLOUD_GPS_LOG_LEVEL_DBG=y

# Refresh rates

CONFIG_MQTT_SN_REFRESH_PERIOD_SECONDS=5
CONFIG_LOCATION_REFRESH_PERIOD_SECONDS=60
```

## boards/nrf7002dk_nrf5340_cpuapp.conf
```kconfig
#
# Copyright (c) 2023 Nordic Semiconductor ASA
#
# SPDX-License-Identifier: LicenseRef-Nordic-5-Clause
#

# Configuration file for nRF7002 DK
# This file is merged with prj.conf in the application folder, and options
# set here will take precedence if they are present in both files.

# General
CONFIG_POSIX_CLOCK=y
CONFIG_POSIX_MAX_FDS=8
CONFIG_SYSTEM_WORKQUEUE_STACK_SIZE=4096
CONFIG_LOG_BUFFER_SIZE=3072
CONFIG_HEAP_MEM_POOL_SIZE=153600
CONFIG_HW_STACK_PROTECTION=y
CONFIG_HW_ID_LIBRARY_SOURCE_NET_MAC=y
# CONFIG_DK_LIBRARY=y

# Set newlib C to prevent build error complaining that string.h is not supported
CONFIG_NEWLIB_LIBC=y

# Wi-Fi
CONFIG_WIFI=y
CONFIG_WIFI_NRF700X=y
CONFIG_WIFI_LOG_LEVEL_ERR=y
CONFIG_WIFI_MGMT_EXT=y
CONFIG_WIFI_CREDENTIALS=y
CONFIG_WIFI_CREDENTIALS_BACKEND_SETTINGS=y
CONFIG_WIFI_CREDENTIALS_STATIC=y
CONFIG_FLASH=y
CONFIG_FLASH_PAGE_LAYOUT=y
CONFIG_FLASH_MAP=y
CONFIG_NVS=y
CONFIG_SETTINGS=y
CONFIG_SETTINGS_NVS=y

# WPA
CONFIG_WPA_SUPP=y
CONFIG_WPA_SUPP_LOG_LEVEL_ERR=y

# NET sockets
CONFIG_NET_L2_ETHERNET=y
CONFIG_NET_IPV4=y
CONFIG_NET_TCP=y
CONFIG_NET_TCP_WORKQ_STACK_SIZE=2048
CONFIG_NET_UDP=y
CONFIG_NET_SOCKETS_OFFLOAD=n
CONFIG_NET_NATIVE=y
CONFIG_NET_DHCPV4=y
CONFIG_NET_CONTEXT_SNDTIMEO=y
CONFIG_NET_MGMT_EVENT_STACK_SIZE=4096

# DNS
CONFIG_DNS_RESOLVER=y
```

## src/main.c
```c
// Libraries
#include <string.h>
#include <zephyr/kernel.h>
#include <nrf_modem_at.h>
#include <modem/lte_lc.h>
#include <modem/location.h>
#include <date_time.h>
#include <zephyr/logging/log.h>

#include <zephyr/drivers/gpio.h>

// Application specific imports
#include "LocationEngine/LocationEngine.h"
#include "Dispatcher/Dispatcher.h"
#include "Responder/Responder.h"
#include "UDPListener/UDPListener.h"

LOG_MODULE_REGISTER(main, 4);

/* Indoor location engine sends 1 for PSM mode and 0 for eDRX mode */
#define POWER_MODE_COMMAND_PIN		DT_ALIAS(gpiocus10)

static const struct gpio_dt_spec power_mode_command_recv_pin = GPIO_DT_SPEC_GET_OR(POWER_MODE_COMMAND_PIN, gpios, {0});

static K_SEM_DEFINE(lte_connected, 0, 1);

static K_SEM_DEFINE(time_update_finished, 0, 1);

static void date_time_evt_handler(const struct date_time_evt *evt)
{
	k_sem_give(&time_update_finished);
}

static void lte_event_handler(const struct lte_lc_evt *const evt)
{
	switch (evt->type) {
	case LTE_LC_EVT_NW_REG_STATUS:
		if ((evt->nw_reg_status == LTE_LC_NW_REG_REGISTERED_HOME) ||
		     (evt->nw_reg_status == LTE_LC_NW_REG_REGISTERED_ROAMING)) {
			LOG_INF("Connected to LTE");
			k_sem_give(&lte_connected);
		}
		break;
	default:
		break;
	}
}

/**
 * @brief Initialize LTE and wait for connection.
*/
static int initializeLte() {
	int err;

	if (IS_ENABLED(CONFIG_DATE_TIME)) {
		/* Registering early for date_time event handler to avoid missing
		 * the first event after LTE is connected.
		 */
		date_time_register_handler(date_time_evt_handler);
	}

	LOG_INF("Connecting to LTE...");

	lte_lc_init();
	lte_lc_register_handler(lte_event_handler);

	/* Enable PSM. */
	/* Turn on LTE power saving features. Also,
	 * request power saving features before network registration. Some
	 * networks rejects timer updates after the device has registered to the
	 * LTE network.
	 */
	lte_lc_psm_req(false);
	/** enhanced Discontinuous Reception */

	LOG_INF("Requesting EDRX mode");
	// Todo: Turn on EDRX mode after development complete.
	err = lte_lc_edrx_req(true);
	
	if (err) {
		LOG_INF("lte_lc_edrx_req, error: %d\n", err);
	}

	err = lte_lc_connect();

	k_sem_take(&lte_connected, K_FOREVER);

	return err;
}

/**
 * @brief Initialize location services.
 * 
 * DOES NOT call method to request location, only initializes the library.
*/
static int initializeLocation() {
		/* A-GPS/P-GPS needs to know the current time. */
	if (IS_ENABLED(CONFIG_DATE_TIME)) {
		LOG_INF("Waiting for current time");

		/* Wait for an event from the Date Time library. */
		k_sem_take(&time_update_finished, K_MINUTES(10));

		if (!date_time_is_valid()) {
			LOG_INF("Failed to get current time. Continuing anyway.");
		}
	}

	int err = location_init(location_event_handler);
	if (err) {
		LOG_INF("Initializing the Location library failed, error: %d", err);
		return -1;
	}
	
	return err;
}

#define BUTTON_DEBOUNCE_TIME 50
uint32_t last_button_press_time;
/**
 * @brief Callback function for when the power mode command is received through gpio interrupt.
*/
static void power_mode_command_recieved() {
	k_sleep(K_MSEC(100));
	int power_mode_command = gpio_pin_get_dt(&power_mode_command_recv_pin);
 	uint32_t newPressTime = k_uptime_get_32();
	
	if (k_uptime_get_32() - last_button_press_time < BUTTON_DEBOUNCE_TIME) {
		return;
	}

	if (power_mode_command == 0) {
		LOG_INF("Power mode set to eDRX");
		// lte_lc_psm_req(false);
		lte_lc_edrx_req(true);
		
	} else if (power_mode_command == 1) {
		LOG_INF("Power mode set to PSM");
		lte_lc_psm_req(true);
		lte_lc_edrx_req(false);
	}
	
	last_button_press_time = newPressTime;

}

static struct gpio_callback pwr_mode_cb_data;

/**
 * @brief Application entry point.
*/
int main(void) {


	LOG_INF("*******************************");
	LOG_INF("Welcome to FindMyCat v2.0");
	LOG_INF("*******************************");
	
retry:
	if (!device_is_ready(power_mode_command_recv_pin.port)) {
		LOG_ERR("Error: Device %s is not ready\n", power_mode_command_recv_pin.port->name);
		goto retry;
	}

	int err;	
	int retry_count = 0;

	err = gpio_pin_configure_dt(&power_mode_command_recv_pin, GPIO_INPUT | GPIO_PULL_DOWN);
	if (err != 0) {
		LOG_ERR("Error %d: failed to configure %s pin %d\n", 
			err, power_mode_command_recv_pin.port->name, power_mode_command_recv_pin.pin);
		goto retry;
	}

	err = gpio_pin_interrupt_configure_dt(&power_mode_command_recv_pin, GPIO_INT_EDGE_BOTH);
	if (err != 0) {
		LOG_ERR("Error %d: failed to configure interrupt on %s pin %d\n",
			err, power_mode_command_recv_pin.port->name, power_mode_command_recv_pin.pin);
		return -1;
	}


	gpio_init_callback(&pwr_mode_cb_data, power_mode_command_recieved, BIT(power_mode_command_recv_pin.pin));
	gpio_add_callback(power_mode_command_recv_pin.port, &pwr_mode_cb_data);

	// Connect to LTE network with retries if necessary.
    while (retry_count < CONFIG_LTE_CONNECT_MAX_RETRIES) {
        err = initializeLte();

        if (err) {
            LOG_INF("Failed to connect to LTE with error: %d\n", err);
            retry_count++;
            k_sleep(K_MSEC(CONFIG_LTE_CONNECT_RETRY_DELAY_S * 1000));
        } else {
			break;
		}
    }

	if (retry_count == CONFIG_LTE_CONNECT_MAX_RETRIES) {
	    LOG_ERR("Max retry limit reached for connecting to LTE, program exiting.");
		return -1;
	}

	retry_count = 0;
	// Initialize location services with retries if necessary.
    while (retry_count < CONFIG_LOCATION_SERVICES_INIT_MAX_RETRIES) {
        err = initializeLocation();

        if (err) {
            LOG_INF("Failed to initialize location services with error: %d\n", err);
            retry_count++;
            k_sleep(K_MSEC(CONFIG_LOCATION_SERVICES_INIT_RETRY_DELAY_S * 1000));
        } else {
			break;
		}
    }

	if (retry_count == CONFIG_LTE_CONNECT_MAX_RETRIES) {
	    LOG_ERR("Max retry limit reached for initializing location services, program exiting.");
		return -1;
	}

	udp_listener_init();

	return 0;
}
```

## src/location.c
```c
#include "location.h"
#include <zephyr/kernel.h>
#include <modem/location.h>
#include <zephyr/logging/log.h>

K_SEM_DEFINE(location_event, 0, 1);

LOG_MODULE_REGISTER(gnss, 4);

void location_event_handler(const struct location_event_data *event_data)
{
	switch (event_data->id) {
	case LOCATION_EVT_LOCATION:
		LOG_INF("Got location:\n");
		printk("  method: %s\n", location_method_str(event_data->method));
		printk("  latitude: %.06f\n", event_data->location.latitude);
		printk("  longitude: %.06f\n", event_data->location.longitude);
		printk("  accuracy: %.01f m\n", event_data->location.accuracy);
		if (event_data->location.datetime.valid) {
			printk("  date: %04d-%02d-%02d\n",
				event_data->location.datetime.year,
				event_data->location.datetime.month,
				event_data->location.datetime.day);
			printk("  time: %02d:%02d:%02d.%03d UTC\n",
				event_data->location.datetime.hour,
				event_data->location.datetime.minute,
				event_data->location.datetime.second,
				event_data->location.datetime.ms);
		}
		printk("  Google maps URL: https://maps.google.com/?q=%.06f,%.06f\n\n",
			event_data->location.latitude, event_data->location.longitude);
		break;

	case LOCATION_EVT_TIMEOUT:
		LOG_ERR("Getting location timed out\n\n");
		break;

	case LOCATION_EVT_ERROR:
		LOG_ERR("Getting location failed\n\n");
		break;

	case LOCATION_EVT_GNSS_ASSISTANCE_REQUEST:
		LOG_INF("Getting location assistance requested (A-GPS). Not doing anything.\n\n");
		break;

	case LOCATION_EVT_GNSS_PREDICTION_REQUEST:
		LOG_INF("Getting location assistance requested (P-GPS). Not doing anything.\n\n");
		break;

	default:
		LOG_INF("Getting location: Unknown event\n\n");
		break;
	}

	k_sem_give(&location_event);
}

void location_event_wait(void)
{
	k_sem_take(&location_event, K_FOREVER);
}

/**
 * @brief Retrieve location so that fallback is applied.
 *
 * @details This is achieved by setting GNSS as first priority method and giving it too short
 * timeout. Then a fallback to next method, which is cellular in this example, occurs.
 */
void location_with_fallback_get(void)
{
	int err;
	struct location_config config;
	enum location_method methods[] = {LOCATION_METHOD_GNSS, LOCATION_METHOD_CELLULAR};

	location_config_defaults_set(&config, ARRAY_SIZE(methods), methods);
	/* GNSS timeout is set to 1 second to force a failure. */
	config.methods[0].gnss.timeout = 1 * MSEC_PER_SEC;
	/* Default cellular configuration may be overridden here. */
	config.methods[1].cellular.timeout = 40 * MSEC_PER_SEC;

	LOG_INF("Requesting location with short GNSS timeout to trigger fallback to cellular...\n");

	err = location_request(&config);
	if (err) {
		LOG_ERR("Requesting location failed, error: %d\n", err);
		return;
	}

	location_event_wait();
}

/**
 * @brief Retrieve location with default configuration.
 *
 * @details This is achieved by not passing configuration at all to location_request().
 */
void location_default_get(void)
{
	int err;

	LOG_INF("Requesting location with the default configuration...\n");

	err = location_request(NULL);
	if (err) {
		LOG_ERR("Requesting location failed, error: %d\n", err);
		return;
	}

	location_event_wait();
}

/**
 * @brief Retrieve location with GNSS low accuracy.
 */
void location_gnss_low_accuracy_get(void)
{
	int err;
	struct location_config config;
	enum location_method methods[] = {LOCATION_METHOD_GNSS};

	location_config_defaults_set(&config, ARRAY_SIZE(methods), methods);
	config.methods[0].gnss.accuracy = LOCATION_ACCURACY_LOW;

	LOG_INF("Requesting low accuracy GNSS location...\n");

	err = location_request(&config);
	if (err) {
		LOG_ERR("Requesting location failed, error: %d\n", err);
		return;
	}

	location_event_wait();
}

/**
 * @brief Retrieve location with GNSS high accuracy.
 */
void location_gnss_high_accuracy_get(void)
{
	int err;
	struct location_config config;
	enum location_method methods[] = {LOCATION_METHOD_GNSS};

	location_config_defaults_set(&config, ARRAY_SIZE(methods), methods);
	config.methods[0].gnss.accuracy = LOCATION_ACCURACY_HIGH;

	LOG_INF("Requesting high accuracy GNSS location...\n");

	err = location_request(&config);
	if (err) {
		LOG_ERR("Requesting location failed, error: %d\n", err);
		return;
	}

	location_event_wait();
}

/**
 * @brief Retrieve location periodically with GNSS as first priority and cellular as second.
 */
void location_gnss_periodic_get(int period)
{
	int err;
	struct location_config config;
	enum location_method methods[] = {LOCATION_METHOD_GNSS, LOCATION_METHOD_CELLULAR};

	location_config_defaults_set(&config, ARRAY_SIZE(methods), methods);
	config.interval = period;

	printk("Requesting %d s periodic GNSS location with cellular fallback...\n", period);

	err = location_request(&config);
	if (err) {
		LOG_ERR("Requesting location failed, error: %d\n", err);
		return;
	}
}
```
